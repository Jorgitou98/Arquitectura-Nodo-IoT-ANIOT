## Práctica 3/Parte avanzada/Contador binario/Kconfig.projbuild
```kconfig
menu "App Configuration"
    config GPIO_OUTPUT_0
        int "Bit 0 output GPIO number"
        range 0 33
        default 18
        help
            GPIO number to write the LED 0 output.

    config GPIO_OUTPUT_1
        int "Bit 0 output GPIO number"
        range 0 33
        default 5
        help
            GPIO number to write the LED 1 output.

    config GPIO_OUTPUT_2
        int "Bit 0 output GPIO number"
        range 0 33
        default 17
        help
            GPIO number to write the LED 2 output.

    config GPIO_OUTPUT_3
        int "Bit 0 output GPIO number"
        range 0 33
        default 16
        help
            GPIO number to write the LED 3 output.

    config GPIO_INPUT
        int "Input GPIO number"
        range 0 33
        default 2
        help
            GPIO number to read.

    config TIMER_COUNT_PERIOD_MS
        int "Counting timer period in miliseconds"
        range 10 3600000
        default 1000
        help
            Define the counting timer period in milliseconds.

    config TIMER_READ_PERIOD_MS
        int "Reading timer period in miliseconds"
        range 10 3600000
        default 500
        help
            Define the reading timer period in milliseconds.
endmenu
```

## Práctica 3/Parte avanzada/Interrupciones/Kconfig.projbuild
```kconfig
menu "GPIO Input Configuration"
    config GPIO_INPUT
        int "Input GPIO number"
        range 0 33
        default 18
        help
            GPIO number to read input.
endmenu
```

## Práctica 3/Parte básica/Encendido de LEDs con GPIO/Kconfig.projbuild
```kconfig
menu "GPIO Output Configuration"
    config GPIO_OUTPUT
        int "Output GPIO number"
        range 0 33
        default 18
        help
            GPIO number to write the LED output.

    config TIMER_WRITE_PERIOD_MS
        int "Reading timer period in miliseconds"
        range 10 3600000
        default 2000
        help
            Define the reading timer period in milliseconds.
endmenu
```

## Práctica 3/Parte básica/Lectura GPIO/Kconfig.projbuild
```kconfig
menu "GPIO Input Configuration"
    config GPIO_INPUT
        int "Input GPIO number"
        range 0 33
        default 18
        help
            GPIO number to read input.

    config TIMER_READ_PERIOD_MS
        int "Reading timer period in miliseconds"
        range 10 3600000
        default 200
        help
            Define the reading timer period in milliseconds.
endmenu
```

## Práctica 3/Parte básica/Uso de timers/Kconfig.projbuild
```kconfig
menu "GPIO Output Configuration"
    config SAMPLING_PERIOD_MS
        int "Sampling timer period in miliseconds"
        range 10 3600000
        default 2000
        help
            Define the sampling timer period in milliseconds.
endmenu
```

## Práctica 4/Parte avanzada/Ejercicio Avanzado/Kconfig.projbuild
```kconfig
menu "App Configuration"
    config NUMBER_SAMPLES_DISTANCE
        int "Number of samples for a ADC reading"
        range 1 400
        default 50
        help
            Number of samples for a ADC reading.

    config READING_DISTANCE_PERIOD_MS
        int "Reading distance period in miliseconds"
        range 10 3600000
        default 2000
        help
            Define the reading distance period in milliseconds.

    config ADC1_CHAN
        int "ADC1 channel for reading"
        range 0 7
        default 6
        help
            ADC1 channel for reading

    config READING_HALL_PERIOD_MS
        int "Reading hall period in miliseconds"
        range 10 3600000
        default 1000
        help
            Define the reading hall period in milliseconds.

    config COUNTING_PERIOD_MS
        int "Counting period in miliseconds"
        range 10 3600000
        default 1000
        help
            Counting period in milliseconds.

    config GPIO_OUTPUT_0
        int "Bit 0 output GPIO number"
        range 0 33
        default 19
        help
            GPIO number to write the LED 0 output.

    config GPIO_OUTPUT_1
        int "Bit 0 output GPIO number"
        range 0 33
        default 18
        help
            GPIO number to write the LED 1 output.

    config GPIO_OUTPUT_2
        int "Bit 0 output GPIO number"
        range 0 33
        default 5
        help
            GPIO number to write the LED 2 output.

    config GPIO_BUTTON
        int "GPIO number for button input"
        range 0 33
        default 25
        help
            GPIO number for button input
endmenu
```

## Práctica 4/Parte básica/Lectura distancias/Kconfig.projbuild
```kconfig
menu "App Configuration"
    config NUMBER_SAMPLES
        int "Number of samples for a ADC reading"
        range 1 400
        default 50
        help
            Number of samples for a ADC reading.

    config READING_PERIOD_MS
        int "Reading timer period in miliseconds"
        range 10 3600000
        default 1000
        help
            Define the reading timer period in milliseconds.

    config ADC1_CHAN
        int "ADC1 channel for reading"
        range 0 7
        default 6
        help
            ADC1 channel for reading
endmenu
```

## Práctica 5/Parte avanzada/Aplicacion con FSM/components/FSM/Kconfig.projbuild
```kconfig
menu "FSM Configuration"
    config PERIOD_HALL_SEC
        int "Period sampling hall in seconds"
        range 1 3600
        default 1
        help
            Period sampling hall in seconds

    config PERIOD_TEMP_SEC
        int "Period sampling temperature in seconds"
        range 1 3600
        default 2
        help
            Period sampling temperature in seconds

    config PERIOD_SHOW_SEC
        int "Period show results in seconds"
        range 1 3600
        default 5
        help
            Period show results in seconds

    config PERIOD_BLINK_MS
        int "Period blink in ms"
        range 10 3600000
        default 1000
        help
            Period blink in milliseconds   
endmenu
```

## Práctica 5/Parte avanzada/Aplicacion con FSM/components/LEDs/Kconfig.projbuild
```kconfig
menu "LEDs Configuration"
    config GPIO_OUTPUT_0
        int "Pin for led 0"
        range 0 33
        default 17
        help
            Pin for led 0

    config GPIO_OUTPUT_1
        int "Pin for led 1"
        range 0 33
        default 16
        help
            Pin for led 1

    config GPIO_OUTPUT_2
        int "Pin for led 2"
        range 0 33
        default 4
        help
            Pin for led 2

    config GPIO_OUTPUT_3
        int "Pin for led 3"
        range 0 33
        default 0
        help
            Pin for led 3
endmenu
```

## Práctica 5/Parte básica/Lectura de temperatura/components/si7021/Kconfig.projbuild
```kconfig
menu "SI7021 Configuration"
    config I2C_MASTER_NUM
        int "Number of I2C controller"
        range 0 1
        default 0
        help
            Number of I2C controller use for SI7021 sensor.

    config I2C_MASTER_SDA_IO
        int "Pin for SDA line"
        range 0 33
        default 18
        help
            Pin for SDA line

    config I2C_MASTER_SCL_IO
        int "Pin for SCL line"
        range 0 33
        default 19
        help
            Pin for SCL line
endmenu
```

## Práctica 5/Parte básica/Lectura de temperatura/main/Kconfig.projbuild
```kconfig
menu "Main Configuration"
    config TEMP_PERIOD_MS
        int "Reading temperature timer in ms"
        range 10 3600000
        default 1000
        help
            Reading temperature timer in milliseconds.
endmenu
```

## Práctica 7/Parte avanzada/components/button/Kconfig.projbuild
```kconfig
menu "Button Configuration"
    config GPIO_BUTTON
    int "GPIO number for button input"
    range 0 33
    default 0
    help
        GPIO number for button input
endmenu
```
